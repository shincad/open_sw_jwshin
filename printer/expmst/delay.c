/*=============================================================*/
/*  KD Line Printer Controller Firmware V2.2                   */
/*  TITLE    : delay.c                                         */
/*  ABSTRACT : Delay Routine                                   */
/*  AUTHOR(S): Jung-Wook Shin                                  */
/*  DATE     : 1999. 1.                                        */
/*  Copyright (c) 1996-1999  by  Jung-Wook Shin                */
/*  Printer Lab. Phoenix Information Technology                */
/*  All rights reserved.                                       */
/*=============================================================*/

/*=============================================================*/
/*                       Include Part                          */
/*=============================================================*/

#include <stdio.h>
#include "define.h"
#include "extern.h"

/*=============================================================*/
/*                     Function Declaration                    */
/*=============================================================*/

Delay(int);
Delay2(int);
Delay3();

/*=============================================================*/
/*                      Delay Routine                          */
/*                    time = 500 per 1.12ms                    */
/*=============================================================*/

Delay(time)
int time;
{
	int m;
   	for(m=0;m<time;m++);
}

/*=============================================================*/
/*                      Delay Routine 2                        */
/*                   time = 100 per 1 sec                      */
/*=============================================================*/

Delay2(time)
int time;
{
	int m,n;
   	for(m=0;m<5000;m++) {
    	for(n=0;n<time;n++);
   	}
}

/*=============================================================*/
/*                     Delay Routine 3                         */
/*                       100ms Delay                           */
/*=============================================================*/

Delay3()
{
	int i,j;
   	for(j=0;j<150;j++) {
    	for(i=0;i<600;i++);
   	}
}
