	.LIST	OFF
;********************************************************
;							*
;	M4324 EEPROM APPLICATION PART MAP DEFINITION	*
;							*
;	FILE NAME	AX_EEP.H			*
;	CREATED 	14/MAR/1991			*
;							*
;********************************************************
;
	.INCLUDE	"SYSEEP.H"
	.LIST		OFF
;
;	EEPROM ADDRESS
;
ZEEA1:	.EQU	  0		; ALARM ERROR CODE
ZEEA2:	.EQU	  1		; SYSTEM DATA START
ZEEA3:	.EQU	 31		; SYSTEM DATA END
ZEEA4:	.EQU	 32		; USER 1 DATA START
ZEEA5:	.EQU	 79		; USER 1 DATA END
ZEEA6:	.EQU	 80		; USER 2 DATA START
ZEEA7:	.EQU	127		; USER 2 DATA END
ZEESZ:	.EQU	128		; EEPROM DATA WORD SIZE
;
;	EEPROM USER DATA
;
E2UID:	.RES.W	  1		; 20  USER ID
E2PFN:	.RES.B	  1		; 21  DEFALT PRINT FORMAT NO.
ZNPFN:	.EQU	  1		;	  MIN. PRINT FORMAT NO.
ZXPFN:	.EQU	  4		;	  MAX. PRINT FORMAT NO.
				;
E2CON:	.RES.B	  1		;     LCD CONTRAST
ZNCON:	.EQU	  0		;	  MIN. CONTRAST
ZXCON:	.EQU	  7		;	  MAX. CONTRAST

E2SIF1: .RES.B	  1		; 22  SERIAL I/F MODE SWITCH 1
;	.EQU	  0		;	    110 bps
;	.EQU	  1		;	    150 bps
;	.EQU	  2		;	    300 bps
;	.EQU	  3		;	    600 bps
;	.EQU	  4		;	   1200 bps
;	.EQU	  5		;	   2400 bps
;	.EQU	  6		;	   4800 bps
;	.EQU	  7		;	   9600 bps
;	.EQU	  8		;	  19200 bps
				;
E2SIF2: .RES.B	  1		;     SERIAL I/F MODE SWITCH 2
;	.EQU	  0->1		;	0:ODD PARITY   1:EVEN  2:NONE
;	.EQU	  2->3		;	0:1 STOP BIT   1:1.5   2:2.0
QXONM:	.EQU	  4		;	1:XON FLOW CONTROL
Q7BIT:	.EQU	  5		;	1:7 BIT DATA LENGTH

E2CPF1: .RES.B	  1		; 23  COMMON PRINT FORMAT SWITCH 1
QNOPHO: .EQU	  0		;	1:NO PAPER BAIL HALF OPEN
QCP261: .EQU	  1		;	1:CUT POSITION FEED 7 INCH
;	.EQU	  2		;
;	.EQU	  3		;
;	.EQU	  4		;
;	.EQU	  5		;
;	.EQU	  6		;
QSLSH0: .EQU	  7		;	1:SLASH 0
				;
E2CPF2: .RES.B	  1		;     COMMON PRINT FORMAT SWITCH 2
QIM150: .EQU	  0		;	1:IMAGE 150CPS MODE
QRBRBM: .EQU	  1		;	1:READ/BLACK RIBBON
QHSMMD: .EQU	  2		;	1:HEAD SHIFT MANUAL MODE
QHSAIN: .EQU	  3		;	1:HAED SHIFT ADJUST AT ACSF INSERT
QCPYEM: .EQU	  4		;	1:COPY ENHANCE MODE
QGRSET: .EQU	  5		;	1:GRAPHIC CHARACTER SET SELECT
QAUTLF: .EQU	  6		;	1:CR -> CR + LF
QHSFIX: .EQU	  7		;	1:HEAD SHIFT FIX MODE

E2PRAV: .RES.B	  1		; 24  PRINT POSITION ADJUST VALUE
ZXPRA:	.EQU	 10		;	  MAX. ADJUST VALUE
	.RES.B	  1		;     RESERVED AREA
KCCBUF: .RES.W	  2		; 25  RESERVED AREA 920801

E2PFTB: 			; 27  PRINT FORMAT TABLE START
;
	.ORG	H'0000
E2PAMD: .RES.B	  1		; 27  DEFALT PAPER MODE
;	.EQU	  0		;	  FORMS MODE
;	.EQU	  1		;	  FORMS MODE   (PAPER HOTCHKISS)
;	.EQU	  2		;	  BOTTOM MODE
;	.EQU	  3		;	  BOTTOM MODE  (PAPER HOTCHKISS)
;	.EQU	  4		;	  SHEET MODE
;	.EQU	  5		;	  ACSF0 MODE   (SF-260)
;	.EQU	  6		;	  ACSF1 MODE   (BIN 1)
;	.EQU	  7		;	  ACSF2 MODE   (BIN 2)
;	.EQU	  8		;	  ACSF3 MODE   (BIN 3)
				;
E2CHSZ: .RES.B	  1		;     CHARCTER SIZE
ZNCHSZ: .EQU	  1		;	   1=1x1
;	.EQU	  2		;	   4=2x2
;	.EQU	  3		;	   9=3x3
;	.EQU	  4		;	  16=4x4
;	.EQU	  5		;	  25=5x5
;	.EQU	  6		;	  36=6x6
;	.EQU	  7		;	  49=7x7
ZXCHSZ: .EQU	  8		;	  64=8x8
				;
E2KJCP: .RES.B	  1		; 28  KANJI PITCH
ZNKJCP: .EQU      1             ; [*sim]95.2.20  MIN.  24/180 INCH
ZXKJCP: .EQU      6             ; [*sim]         MAX.  63/180 INCH
				;
E2WDF:	.RES.B	  1		;     FORMS WIDTH
ZNWDF:	.EQU	  1		;	  MIN.	 1 INCH
ZXWDF:	.EQU	 15		;	  MIN.	15 INCH

E2TOPF: .RES.W	  1		; 29  FORMS TOP MARGIN
E2TOPS: .RES.W	  1		; 2A  SHEET TOP MARGIN
E2TOP0: .RES.W	  1		; 2B  ACSF0 TOP MARGIN
E2TOP1: .RES.W	  1		; 2C  ACSF1 TOP MARGIN
E2TOP2: .RES.W	  1		; 2D  ACSF2 TOP MARGIN
E2TOP3: .RES.W	  1		; 2E  ACSF3 TOP MARGIN
ZNTOP:	.EQU	 15		;	  MIN.	 15/180 INCH
ZXTOP:	.EQU	195		;	  MAX.	195/180 INCH

E2BTM:	.RES.B	  1		; 2F  BOTTOM MARGIN
ZNBTM:	.EQU	  0		;	  MIN.	 0/6 INCH
ZXBTM:	.EQU	  6		;	  MAX.	 6/6 INCH
				;
E2PGL:	.RES.B	  1		;     PAGE LENGTH
ZNPGL:	.EQU	  1		;	  MIN.	 1/6 INCH
ZXPGL:	.EQU	132		;	  MAX. 132/6 INCH

E2PF1:	.RES.B	  1		; 30  PRINT FORMAT SWITCH 1
E2PF2:	.RES.B	  1		;     PRINT FORMAT SWITCH 2
QTEAR:	.EQU	  0		;	1:TEAR OFF MODE
				;
E2PFSZ: 			;     1 FORMAT SIZE
	.LIST	ON
