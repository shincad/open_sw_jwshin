#include "NT686xx_SC_REG.H"
#include "MyDef.h"
#include "Board.h"
#include "Scaler.h"
#include "ROM_MAP.H"
#include "NVRAM.H"
#include "Mis.h"
#include "HDCP.h"
#include <stdio.h>

//#define HDCPDebug

//===========================================
//		WRITE KEY FROM FACTORY:
//		1. LINCENSE KEY = 8+280+20 BYTES (8=KSVx5+0x00x3)
//		2. READ (8+280)
//		3. XOR (280)
//		4. WRITE TO EEPROM (288=OP(0x68); 289=OPERATION(0x00) )
//		
//		LOAD:
//		1. KSV TO SCALER 0x300..0x304
//		2. KEY TO INDEX 0..287 ( 280 KEY + 0x68 + 0x00 + 5 FACTORY_ID )
//		
//===========================================

#if _ENABLE_HDCP_

xdata unsigned char ucHDCPFlag = 0;

xdata unsigned short usNVRamAddr_HDCP;
xdata unsigned short usHDCPChkSum1, usHDCPChkSum2 = 0;


void InitHDCP(void)
{
	WriteHDCPKey();
	EnableHDCP();
}

void WriteHDCPKey(void)
{
	unsigned char tmpReg;
	unsigned short i;
	
//	NVTprintf("[HDCP KEY] WriteHDCPKey\n\r");
	
	WriteIIC560(0x360, 0xC0); // Set Refclk * clk inverted
	WriteIIC560(0x361, 0x08); // Set decryption key
	WriteIIC560(0x369, 0x0B); // Enable HDCP
	
	// Write KSV
	usNVRamAddr_HDCP = NVRAM_HDCP_KEY;

//printf("[HDCP KSV] Start:%04X Num:%d\n\r", usNVRamAddr_HDCP, (unsigned short)NUM_HDCP_KSV);
	for(i=0; i<NUM_HDCP_KSV; i++){
		tmpReg = Read24C16(usNVRamAddr_HDCP+i);
		WriteIIC560(0x300+i, tmpReg);
//		printf("%x ",(unsigned short)tmpReg);
	}
//	printf("--KSV\r\n");	
	usNVRamAddr_HDCP += NUM_HDCP_KSV;

	// Write Key
	tmpReg = ReadIIC560(INDEX_CTRL) & 0x04;
	tmpReg |= 0xE0;
	WriteIIC560(INDEX_CTRL, tmpReg);

//printf("[HDCP KEY] Start:%04X Num:%d\n\r", usNVRamAddr_HDCP, (unsigned short)NUM_HDCP_KEY);
	for(i=0; i<NUM_HDCP_KEY; i++){
		tmpReg = Read24C16(usNVRamAddr_HDCP+i);
		WriteIIC560(INDEX_ADDR_LI,(unsigned char)(i&0xff));
		WriteIIC560(INDEX_ADDR_HI,(unsigned char)(i >> 8));
		WriteIIC560(INDEX_DATA,tmpReg);
//if (i>272)
//	printf("%02x ",(unsigned short)tmpReg);
	}
//printf("--KEY SET\r\n");	
}

void CheckHDCP(void)
{
	unsigned char tmpReg;
	tmpReg = ReadIIC560(0x369);
	
	if((tmpReg & BIT_0) != 0){	// AKSV transfer done
		ucHDCPFlag |= BIT_0;
		printf("AKSV transfer done\r\n");
	}

	if((tmpReg & BIT_1) != 0){	// Authentication done
		ucHDCPFlag |= BIT_1;
		printf("Authentication done\r\n");
	}

	WriteIIC560(0x369,0x0B);
}

void CheckHDCPSyncMode(void)
{
	unsigned char reg;
	
//	NVTprintf("[HDCP KEY] CheckHDCPSyncMode\n\r");
	
	reg = ReadIIC560(GI_SYNC_CTRL);
	WriteIIC560(GI_SYNC_CTRL,0x90);//0x94
	Sleep(20);

	if((ReadIIC560(GI_SYNC_STATUS) & 0xD8) == 0x18){
//		printf("SyncMode 0\r\n");
		WriteIIC560(0x361, 0x08); // Set decryption key
	}
	else{
//		printf("SyncMode 1\r\n");
		WriteIIC560(0x361, 0x0B); // Set decryption key
	}
//#endif

#if DVI_MODE == DVI_DE_MODE
	WriteIIC560(GI_SYNC_CTRL,reg&(~BIT_7));
#else
	WriteIIC560(GI_SYNC_CTRL,reg|BIT_7);
#endif
}

#ifdef NOVATEK_HDCP_WRITER
void StartHDCPStoring(void)
{
	usHDCPChkSum1 = 0;
	usHDCPChkSum2 = 0xffff;
	usNVRamAddr_HDCP = NVRAM_HDCP_KEY;
}

void StoreHDCP( unsigned char *pData,  unsigned short num)
{
	unsigned char i,j;
	
//	printf("[HDCP Write] Start:%04X Num:%d\n\r", usNVRamAddr_HDCP, (unsigned short)num);
	for(i=0; i<(num/8); i++){
		WritePage24C16(usNVRamAddr_HDCP, 0, (pData+(i*8)), 8);
		for(j=0; j<8; j++){
			if((usNVRamAddr_HDCP+j) < (NVRAM_HDCP_KEY+NUM_HDCP_TOTAL))
				usHDCPChkSum1 += *(pData+i*8+j);
//				printf("%x\n\r",usHDCPChkSum1);
//			}
		}
//		printf("%02X ...", (unsigned short)*(pData+i*8));
		usNVRamAddr_HDCP += 8;
	}
	num = num % 8;
	
	for(j = 0; j < num; j++){
		//printf("%x=%02X,", (unsigned short)(usNVRamAddr_HDCP+j),(unsigned short)*(pData+i*8+j));
		Write24C16(usNVRamAddr_HDCP+j, *(pData+i*8+j));
		if((usNVRamAddr_HDCP+j) < (NVRAM_HDCP_KEY+NUM_HDCP_TOTAL))
			usHDCPChkSum1 += *(pData+i*8+j);
//			printf("%x\n\r",usHDCPChkSum1);
//		}
	}
//	printf("\n\r");
	usNVRamAddr_HDCP += num;
//	printf("%d\n\r",usNVRamAddr_HDCP-NVRAM_HDCP_KEY);
}
#endif

#ifdef NOVATEK_HDCP_WRITER
unsigned char CheckHDCPChkSum(void)
{
	usHDCPChkSum2 = Read24C16(NVRAM_HDCP_KEY+0x121);
	usHDCPChkSum2 = usHDCPChkSum2 << 8;
	usHDCPChkSum2 = usHDCPChkSum2 + Read24C16(NVRAM_HDCP_KEY+0x122);

//	printf("0x%04X 0x%04X 0x%04X\n\r",usHDCPChkSum1, usHDCPChkSum2,usNVRamAddr_HDCP);

	if(usHDCPChkSum1 == usHDCPChkSum2)
		return 1;
	else
		return 0;
}
#endif

#ifdef DEMO_HDCP_KEY

void InitHDCP_DemoKey()
{

code unsigned char demo_key[]={
/*
0x2E,0xAC,0xDD,0x91,0x58,0x00,0x00,0x00,

0x2A,0xF6,0x82,0xD5,0x8E,0xA3,0x11,0x45,
0x47,0x2A,0x7E,0x55,0x65,0xE9,0xC0,0x63,0x3C,0xE6,0x54,0xB8,0xED,0x2F,0xAD,0xB6,
0x63,0xA9,0xFC,0xA6,0xFB,0x08,0x48,0x78,0xCC,0x49,0x29,0x36,0xF1,0x51,0x18,0xF4,
0xB0,0x76,0xC4,0xE2,0x01,0x22,0xF1,0xAA,0x58,0x2D,0xF2,0x61,0xDA,0x29,0xB4,0x65,
0xA6,0x05,0xAE,0xD6,0xA6,0x49,0x8E,0xFE,0x8F,0x33,0xB3,0x5D,0xA8,0x53,0xE1,0xD3,
0x04,0x7B,0x4F,0x1C,0xCB,0x75,0xB0,0xEE,0x48,0xCC,0xB8,0x32,0xD6,0x9E,0xE5,0xEA,
0x80,0xD5,0x4A,0xCC,0x21,0xAB,0x0B,0x92,0xA7,0xA4,0xE7,0x41,0xFC,0xCE,0x6F,0xCC,
0xFD,0xEB,0x13,0x23,0xB9,0xD5,0x58,0x30,0x5F,0x4C,0xC3,0x6A,0xF0,0x5F,0x99,0x2F,
0x02,0xA7,0xEB,0xFF,0x4D,0xA0,0x97,0x0B,0x1B,0x5D,0x44,0xBF,0x9D,0x99,0xE0,0xE4,
0x4F,0xE0,0x7F,0x6D,0xD9,0x9F,0xA9,0x6B,0x82,0x83,0xF0,0x17,0x6F,0xFB,0x0C,0x41,
0x32,0x84,0xFE,0x40,0x1B,0x8E,0xA2,0xA8,0x5B,0x69,0x51,0x45,0x5B,0x4A,0x1A,0x46,
0x55,0xC9,0xDC,0xA9,0x07,0x84,0x2C,0x33,0x3B,0xE0,0x38,0x3B,0x46,0xF2,0x05,0x38,
0x1B,0xFD,0x08,0x4E,0x6C,0xB8,0x82,0x2F,0x20,0x30,0x9E,0x24,0x96,0x88,0x46,0x3E,
0xCA,0x2F,0xAF,0x9D,0xB8,0x93,0x4B,0x49,0xE7,0x91,0x07,0xE9,0x2F,0x37,0xC6,0x80,
0x83,0xE0,0x63,0xB2,0xC9,0x28,0x64,0x36,0x89,0x8A,0xA2,0x77,0x13,0x88,0x09,0x08,
0xD1,0xC2,0x55,0x89,0x8C,0x77,0xC9,0xCE,0xDB,0x2E,0x97,0x14,0x4C,0xC0,0xDF,0x0E,
0x7B,0x71,0x1A,0xB3,0xA4,0xAB,0xAB,0x6D,0x23,0x2B,0xF1,0x38,0xFE,0x6F,0x9B,0xCF,
0x39,0x4F,0x71,0xB8,0x98,0x88,0x82,0x00,0x0B,0xD3,0xF2,0x5B,0x63,0x4C,0x7C,0x04,

0x00,0x00
*/

	0x24,0xC8,0xEB,0x3E,0x9C,0x00,0x00,0x00,

	0xF1,0x04,0x43,0x87,0x2C,0x22,0x0D,
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	0x68,0x00,0x01,0x02,0x03,0x04,0x05


};

	StartHDCPStoring();
	
	StoreHDCP(demo_key,	NUM_HDCP_TOTAL);
	
	Write24C16(NVRAM_HDCP_KEY_CRC, 0x00);
	Write24C16(NVRAM_HDCP_KEY_CRC+1, 0x00);

}


#endif

#endif	//#if _ENABLE_HDCP_